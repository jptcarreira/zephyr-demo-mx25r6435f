## CMakeLists.txt
```
# SPDX-License-Identifier: Apache-2.0

list(APPEND ZEPHYR_EXTRA_MODULES
  ${CMAKE_CURRENT_SOURCE_DIR}/octospi_flash_module
  )


cmake_minimum_required(VERSION 3.13.1)

find_package(Zephyr REQUIRED HINTS $ENV{ZEPHYR_BASE})
project(zephyr-demo-mx25r6435f)


target_sources(app PRIVATE src/main.c)
```

## KConfig
```
   mainmenu "MYAPP"

   source "Kconfig.zephyr"
   config MYAPP_STM32
     default y
     bool
     select USE_STM32_HAL_STM32_HAL_OSPI
```

## prj.conf
```kconfig
# For all options check:
# https://docs.zephyrproject.org/latest/reference/kconfig/index-all.html
# Comment/Uncomment to have debug symbols and disable optimizations
CONFIG_APPLICATION_DEFINED_SYSCALL=y
CONFIG_OCTOSPI_FLASH_DRIVER=y 
 
CONFIG_DEBUG=y
CONFIG_NO_OPTIMIZATIONS=y
CONFIG_GPIO=y
CONFIG_I2C=y
CONFIG_SPI=y
CONFIG_SPI_STM32_DMA=n
CONFIG_SENSOR=y
CONFIG_LIS3MDL=y
```

## boards/b_l4s5i_iot01a.overlay
```dts
/*
 * Copyright (c) 2020 STMicroelectronics
 *
 * SPDX-License-Identifier: Apache-2.0
 */

&spi2 {
	status = "okay";
};
```

## src/main.c
```c
/*
 *  Created on: Dec 30, 2020
 *      Author: Joao Carreira
 *
 * SPDX-License-Identifier: Apache-2.0
 *
 */

#include <zephyr.h>
#include "octospi_flash_driver.h"

const struct device *octospi_dev;

char DATA_WRITE[] = "Hello Octo-SPI from Zephyr...";

#define BUFFER_SIZE sizeof(DATA_WRITE)
char BUFFER[ BUFFER_SIZE ];


static void test_flash(void *p1, void *p2, void *p3)
{
	octospi_dev = device_get_binding("OCTOSPI_FLASH_DRIVER");

	// Erase the sector
	printk("Erase sector...\n" );
	octospi_flash_erase_sector(octospi_dev, 0 );

	//TODO: Driver not waiting for operation complete
	k_msleep(60);

	// Read to check if is empty
	octospi_flash_read(octospi_dev, 0, BUFFER, BUFFER_SIZE );
	for( int i=0; i < BUFFER_SIZE; ++i ) {
		if( BUFFER[i] != 0xFF ) {
			printk("Error, data not erased!\n");
		}
	}

	// Write data
	octospi_flash_write(octospi_dev, 0, DATA_WRITE, BUFFER_SIZE );

	// Read to check if data was writen.
	octospi_flash_read(octospi_dev, 0, BUFFER, BUFFER_SIZE );
	BUFFER[ BUFFER_SIZE ] = 0;

	for( int i=0; i < BUFFER_SIZE; ++i ) {
		if( BUFFER[i] != DATA_WRITE[i] ) {
			printk("Error, data written doesn't match!\n");
			return;
		}
	}

	printk("Test succeed!\n");

}

void main(void)
{
	k_thread_user_mode_enter(test_flash, NULL, NULL, NULL);
}
```
